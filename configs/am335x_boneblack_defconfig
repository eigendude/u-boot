## configs/am335x_boneblack_defconfig
```kconfig
CONFIG_ARM=y
CONFIG_ARCH_OMAP2PLUS=y
CONFIG_TI_COMMON_CMD_OPTIONS=y
CONFIG_AM33XX=y
CONFIG_SPL=y
CONFIG_DISTRO_DEFAULTS=y
# CONFIG_SYS_EXTRA_OPTIONS="EMMC_BOOT"
CONFIG_BOOTCOMMAND="run envboot; setenv mmcdev 1; run envboot; setenv mmcdev 0; run findfdt; run distro_bootcmd"
CONFIG_SYS_CONSOLE_INFO_QUIET=y
CONFIG_VERSION_VARIABLE=y
CONFIG_ARCH_MISC_INIT=y
# CONFIG_SPL_MUSB_NEW_SUPPORT is not set
# CONFIG_SPL_NAND_SUPPORT is not set
# CONFIG_SPL_OS_BOOT is not set
CONFIG_AUTOBOOT_KEYED=y
CONFIG_AUTOBOOT_PROMPT="Press SPACE to abort autoboot in %d seconds\n"
CONFIG_AUTOBOOT_DELAY_STR="d"
CONFIG_AUTOBOOT_STOP_STR=" "
CONFIG_CMD_SPL=y
# CONFIG_CMD_FLASH is not set
# CONFIG_CMD_SETEXPR is not set
# CONFIG_ENV_IS_IN_MMC is not set
CONFIG_ENV_IS_NOWHERE=y
# CONFIG_ENV_VARS_UBOOT_RUNTIME_CONFIG is not set
# CONFIG_BOOTCOUNT_LIMIT is not set
# CONFIG_DFU_TFTP is not set
# CONFIG_DFU_MMC is not set
# CONFIG_DFU_RAM is not set
# CONFIG_USB_FUNCTION_FASTBOOT is not set
# CONFIG_FASTBOOT_FLASH is not set
# CONFIG_FASTBOOT_FLASH_MMC_DEV is not set
# CONFIG_FASTBOOT_CMD_OEM_FORMAT is not set
CONFIG_MMC_OMAP_HS=y
# CONFIG_SPI_FLASH is not set
# CONFIG_SPI_FLASH_WINBOND is not set
# CONFIG_DRIVER_TI_CPSW is not set
CONFIG_SYS_NS16550=y
CONFIG_SPI=y
CONFIG_OMAP3_SPI=y
# CONFIG_USB is not set
CONFIG_LZO=y
CONFIG_OF_LIBFDT=y
CONFIG_BOOTDELAY=0
```

## configs/am335x_evm_defconfig
```kconfig
################################################################################
#
# System configuration
#
################################################################################

# CPU configuration
CONFIG_ARM=y
CONFIG_ARCH_CPU_INIT=y
CONFIG_ARCH_OMAP2PLUS=y
CONFIG_ARCH_MISC_INIT=y
CONFIG_TI_COMMON_CMD_OPTIONS=y
CONFIG_AM33XX=y

# Logging configuration
CONFIG_LOGLEVEL=8
CONFIG_SYS_CONSOLE_INFO_QUIET=n

# Size optimizations
CONFIG_DYNAMIC_CRC_TABLE=y

# General configuration
CONFIG_DISTRO_DEFAULTS=y
CONFIG_VERSION_VARIABLE=y
CONFIG_SYS_RELOC_GD_ENV_ADDR=y
CONFIG_ENV_VARS_UBOOT_RUNTIME_CONFIG=y
CONFIG_LZO=y
CONFIG_BOOTCOUNT_LIMIT=y

# MMC configuration
#CONFIG_ENV_IS_IN_MMC=y

################################################################################
#
# Enable features
#
################################################################################

# UEFI features
CONFIG_BLK=y
CONFIG_EFI_LOADER=y
CONFIG_PARTITIONS=y
CONFIG_EFI_PARTITION=y

# Clock features
CONFIG_CLK=y
CONFIG_CLK_CDCE9XX=y

# I2C features
CONFIG_DM_I2C=y

# MMC features
CONFIG_DM_MMC=y
CONFIG_MMC_OMAP_HS=y
CONFIG_SF_DEFAULT_SPEED=24000000

# Ethernet features
CONFIG_DM_ETH=y
CONFIG_DRIVER_TI_CPSW=y
CONFIG_MII=y

# Timer features
CONFIG_TIMER=y
CONFIG_OMAP_TIMER=y
CONFIG_WDT=y

# USB features (TODO)
CONFIG_USB=y
CONFIG_DM_USB=y
CONFIG_DM_USB_GADGET=y
CONFIG_USB_MUSB_HOST=y
CONFIG_USB_MUSB_GADGET=y
CONFIG_USB_MUSB_TI=y
CONFIG_USB_GADGET=y
CONFIG_USB_GADGET_MANUFACTURER="Texas Instruments"
CONFIG_USB_GADGET_VENDOR_NUM=0x0451
CONFIG_USB_GADGET_PRODUCT_NUM=0xd022
CONFIG_USB_ETHER=y

# Miscellaneous drivers
CONFIG_MISC=y

################################################################################
# Disable features
################################################################################

# Flattened device tree support
CONFIG_OF_CONTROL=n
CONFIG_OF_BOARD_SETUP=n
CONFIG_OF_LIBFDT_OVERLAY=n
CONFIG_DEFAULT_DEVICE_TREE="am335x-evm"
CONFIG_OF_LIST="am335x-evm am335x-bone am335x-boneblack am335x-evmsk am335x-bonegreen am335x-icev2 am335x-pocketbeagle"
CONFIG_RSA=n

# Flash features
CONFIG_MTD=n
CONFIG_MTD_RAW_NAND=n
CONFIG_MTD_NOR_FLASH=n
CONFIG_DM_MTD=n

# DFU features
CONFIG_DFU_MMC=n
CONFIG_DFU_NAND=n
CONFIG_DFU_RAM=n
CONFIG_DFU_TFTP=y

# Fastboot features
CONFIG_FASTBOOT=n
CONFIG_USB_FUNCTION_FASTBOOT=n
CONFIG_UDP_FUNCTION_FASTBOOT=n

# MMC features
CONFIG_MMC_HW_PARTITIONING=n
CONFIG_SUPPORT_EMMC_BOOT=n

# SPI features
CONFIG_SPI=n
CONFIG_DM_SPI=n

# FPGA features
CONFIG_FPGA=n

################################################################################
#
# SPL configuration
#
################################################################################

# General configuration
CONFIG_SPL=y
CONFIG_SPL_ENV_IS_NOWHERE=y
CONFIG_SPL_DISPLAY_PRINT=y

# U-Boot configuration
CONFIG_SYS_MMCSD_RAW_MODE_U_BOOT_USE_SECTOR=y
CONFIG_MMCSD_RAW_MODE_U_BOOT_SECTOR=0x300 # 768 sectors = 384 KiB
CONFIG_SYS_MMCSD_RAW_MODE_U_BOOT_USE_PARTITION=n

# TODO: Explore FIT (Flattened Image Tree) someday
CONFIG_SPL_FIT=n

# MMC configuration
CONFIG_SPL_BLK=n
CONFIG_SUPPORT_EMMC_BOOT=n

# Timer features
CONFIG_SPL_WDT=n

# Filesystem features
CONFIG_SPL_FS_FAT=n
CONFIG_SPL_FS_EXT4=n

# Ethernet features
CONFIG_SPL_ETH_SUPPORT=n
CONFIG_SPL_NET_SUPPORT=n
CONFIG_SPL_NET_VCI_STRING="AM335x U-Boot SPL"

# Flash features
CONFIG_SPL_MTD_SUPPORT=n
CONFIG_SPL_NAND_SUPPORT=n
CONFIG_CMD_SPL_NAND_OFS=n

# USB features
CONFIG_SPL_DM_USB_GADGET=n
CONFIG_SPL_MUSB_NEW_SUPPORT=n
CONFIG_SPL_USB_GADGET=n
CONFIG_SPL_USB_ETHER=n

# Falcon boot
CONFIG_SPL_OS_BOOT=n
CONFIG_CMD_SPL=n
```
